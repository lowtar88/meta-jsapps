## conf/layer.conf
```bitbake
# We have a conf and classes directory, add to BBPATH
BBPATH .= ":${LAYERDIR}"

# We have recipes-* directories, add to BBFILES
BBFILES += "${LAYERDIR}/recipes-*/*/*.bb \
            ${LAYERDIR}/recipes-*/*/*.bbappend"

BBFILE_COLLECTIONS += "meta-jsapps"
BBFILE_PATTERN_meta-jsapps = "^${LAYERDIR}/"
BBFILE_PRIORITY_meta-jsapps = "6"

LAYERDEPENDS_meta-jsapps = "core"
LAYERSERIES_COMPAT_meta-jsapps = "dunfell"
```
